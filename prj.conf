## CMakeLists.txt
```
#
# Copyright (c) 2021 Nordic Semiconductor ASA
#
# SPDX-License-Identifier: LicenseRef-Nordic-5-Clause
#

cmake_minimum_required(VERSION 3.20.0)

# Partition Manager file
set(PM_STATIC_YML_FILE ${CMAKE_CURRENT_SOURCE_DIR}/configuration/${BOARD}/pm_static.yml)
message(STATUS "PM_STATIC_YML_FILE: ${PM_STATIC_YML_FILE}")
find_package(Zephyr REQUIRED HINTS $ENV{ZEPHYR_BASE})

project(dual_wireless_test_uart)

# NORDIC SDK APP START
target_sources(app PRIVATE
  src/main.c
  src/zigbee_bdb.c
  src/Tcu_Uart.c
  src/zigbee_aps.c
  src/zigbee_configuration.c
  src/Digi_node_discovery.c
  src/Digi_At_commands.c
  src/Digi_wireless_at_commands.c
  src/nvram.c
  src/Digi_fota.c
  src/OTA_dfu_target.c
  src/system.c
)

target_include_directories(app PRIVATE include)
# NORDIC SDK APP END
```

## Kconfig
```
source "Kconfig.zephyr"
config PAN1770EVB
	bool "The evaluation board is PAN1770EVB"
	default n
```

## sysbuild.conf
```
# Sysbuild configuration file.
# Enable MCUboot per default for this sample.
SB_CONFIG_BOOTLOADER_MCUBOOT=y
SB_CONFIG_MCUBOOT_MODE_SINGLE_APP=n

SB_CONFIG_PARTITION_MANAGER=y

SB_CONFIG_BOOT_SIGNATURE_KEY_FILE="\${APP_DIR}/private_key.pem"

SB_CONFIG_BOOT_SIGNATURE_TYPE_ECDSA_P256=y
```

## prj.conf
```kconfig
#
# Copyright (c) 2021 Nordic Semiconductor ASA
#
# SPDX-License-Identifier: LicenseRef-Nordic-5-Clause
#

CONFIG_PAN1770EVB=y

#CONFIG_NCS_SAMPLES_DEFAULTS=y
# Configure Non Volatile memory
CONFIG_NVS=y
CONFIG_NVS_LOG_LEVEL_DBG=y
CONFIG_MPU_ALLOW_FLASH_WRITE=y

# LOG configuration
#CONFIG_LOG_CMDS=y
CONFIG_LOG_MODE_DEFERRED=y
#CONFIG_LOG_BUFFER_SIZE=4096
#CONFIG_LOG_PROCESS_THREAD_STACK_SIZE=1024
#CONFIG_LOG_PROCESS_THREAD_STARTUP_DELAY_MS=1000
CONFIG_LOG=y
CONFIG_LOG_PRINTK=n

CONFIG_ZIGBEE_APP_UTILS_LOG_LEVEL_DBG=y

CONFIG_HWINFO=y
# Configure serial Interrupt driven for test
CONFIG_RING_BUFFER=y
CONFIG_UART_INTERRUPT_DRIVEN=y
CONFIG_UART_USE_RUNTIME_CONFIGURE=y

# RC Oscillator
CONFIG_CLOCK_CONTROL_NRF_K32SRC_RC=y

# Heap memory pool remove??
#CONFIG_HEAP_MEM_POOL_SIZE=4096
#CONFIG_MAIN_THREAD_PRIORITY=7

CONFIG_ZIGBEE=y
CONFIG_ZIGBEE_APP_UTILS=y
CONFIG_ZIGBEE_ROLE_ROUTER=y

# This example requires more workqueue stack
#CONFIG_SYSTEM_WORKQUEUE_STACK_SIZE=2048

# Enable nRF ECB driver
CONFIG_CRYPTO=y
CONFIG_CRYPTO_NRF_ECB=y
CONFIG_CRYPTO_INIT_PRIORITY=80

# Networking
CONFIG_NET_IPV6=n
CONFIG_NET_IP_ADDR_CHECK=n
CONFIG_NET_UDP=n

#Connecting Nordic device to a third-party Coordinator
CONFIG_ZIGBEE_CHANNEL_SELECTION_MODE_MULTI=y

#timer conf
CONFIG_NRFX_TIMER1=y

CONFIG_PRINTK=y

# Watchdog configuration
CONFIG_WATCHDOG=y
CONFIG_WDT_LOG_LEVEL_DBG=y
CONFIG_WDT_DISABLE_AT_BOOT=y

CONFIG_TASK_WDT=y
CONFIG_TASK_WDT_MIN_TIMEOUT=2000

# Enable Zigbee traces remove??
CONFIG_THREAD_NAME=y
#CONFIG_ZIGBEE_DEBUG_FUNCTIONS=y
#CONFIG_ZIGBEE_ENABLE_TRACES=y

# Enable Zigbee traces remove??
#CONFIG_ZIGBEE_APP_CB_QUEUE_LENGTH=88
CONFIG_ZBOSS_HALT_ON_ASSERT=y

# Enable mcu boot remove??
CONFIG_DEBUG_COREDUMP=y
CONFIG_DEBUG_COREDUMP_BACKEND_LOGGING=y
CONFIG_ZBOSS_ERROR_PRINT_TO_LOG=y

CONFIG_LOG_MODE_IMMEDIATE=y

# DFU Target support
CONFIG_DFU_TARGET=y
CONFIG_DFU_TARGET_MCUBOOT=y

# MCUboot integration
CONFIG_BOOTLOADER_MCUBOOT=y

# Optional: persist write offset across reboots
CONFIG_SETTINGS=y
CONFIG_DFU_TARGET_STREAM_SAVE_PROGRESS=y

# Flash map helpers
CONFIG_FLASH_MAP=y
CONFIG_IMG_MANAGER=y

CONFIG_MCUBOOT_IMGTOOL_SIGN_VERSION="1.0.0"
# Ensure an MCUboot-compatible binary is generated.
CONFIG_IMG_MANAGER=y
CONFIG_STREAM_FLASH=y
CONFIG_IMG_ERASE_PROGRESSIVELY=y


# Enable DFU target to write to slot 1
CONFIG_MCUBOOT_IMG_MANAGER=y

CONFIG_THREAD_STACK_INFO=y

CONFIG_PARTITION_MANAGER_ENABLED=y

CONFIG_MCUBOOT_BOOTUTIL_LIB=y
CONFIG_DFU_TARGET_STREAM=y
CONFIG_STREAM_FLASH_ERASE=y
CONFIG_FLASH=y
CONFIG_FLASH_MAP=y

#----------------------------------------------------------
#--- WARNING: To maintain the integrity of secure boot, ---
#--- enable CONFIG_DISABLE_FLASH_PATCH in production.   ---
#----------------------------------------------------------
#CONFIG_DISABLE_FLASH_PATCH=y
```

## src/main.c
```c
/*
 * Copyright (c) 2025 IED
 *
 */

/**
 * @file main.c
 * @brief Main source file for the dual communication Nordic project.
 *
 *
 * This firmware is designed for the Nordic nRF52840 platform and provides the following features:
 *
 * - Implements a Zigbee Router node using the ZBOSS stack, fully integrated with the Zephyr RTOS.
 * - Provides an AT command interface over UART, supporting both command mode and transparent mode.
 * - Supports wireless AT command reception via Zigbee APS frames, compatible with XBee/Digi style communication.
 * - Enables Firmware Upgrade Over-The-Air (FUOTA) using a custom APS-based transport protocol.
 * - Utilizes Zephyr's flash-backed settings subsystem for NVRAM configuration storage.
 * 
 * @author jetxeberria
 * @date 2025
 */

// TODO: Add only the necessary #include directives for this file
#include <zephyr/kernel.h>
#include <zephyr/logging/log.h>

#include <zboss_api.h>
#include <zigbee/zigbee_error_handler.h>
#include <zigbee/zigbee_app_utils.h>
#include <zb_nrf_platform.h>
#include "zb_range_extender.h"
#include "zb_mem_config_max.h" // This file has to be included after zboss_api.h

#include "global_defines.h"
#include "zigbee_configuration.h"
#include "tcu_Uart.h"
#include "Digi_profile.h"
#include "zigbee_device_profile.h"
#include "zigbee_bdb.h"
#include "zigbee_aps.h"
#include "Digi_At_commands.h"
#include "Digi_node_discovery.h"
#include "Digi_wireless_at_commands.h"
#include "nvram.h"
#include "Digi_fota.h"
#include "OTA_dfu_target.h"
#include "system.h"


LOG_MODULE_REGISTER(main, LOG_LEVEL_INF);

bool g_b_flash_error = false; //   Flag to indicate if there was an error when reading the NVRAM

/* Zigbee messagge info*/
static bool b_infit_info_flag = PRINT_ZIGBEE_INFO;

// boolean flags for detecting modbus request handling
bool b_Zigbe_Connected = false;
bool bTimeToSendFrame = false;

static struct xbee_parameters_t xbee_parameters; // Xbee's parameters


/*----------------------------------------------------------------------------*/
/*                           FUNCTION DEFINITIONS                             */
/*----------------------------------------------------------------------------*/


//------------------------------------------------------------------------------
/**@brief This function prints the value of several Zigbee parameters to the console.
 *
 * @details Information is printed only once and if PRINT_ZIGBEE_INFO is true, after the device has joined a Network
 *
 */
void diagnostic_zigbee_info()
{
    zb_ext_pan_id_t zb_ext_pan_id;

    if(zb_zdo_joined() && b_infit_info_flag == ZB_TRUE)
    {
        b_infit_info_flag = ZB_FALSE;
        b_Zigbe_Connected = true;
        if(PRINT_ZIGBEE_INFO) LOG_DBG("Zigbee application joined the network: bellow some info : \n");

        xbee_parameters.at_my = zb_get_short_address();
        if(PRINT_ZIGBEE_INFO) LOG_DBG("zigbee shrot addr:  0x%x\n", xbee_parameters.at_my);

        zb_get_extended_pan_id(zb_ext_pan_id);
        
        // Display extended PAN ID
        uint8_t temp[8];
        for(uint8_t i = 0; i<8; i++)
        {
            temp[i] = zb_ext_pan_id[7-i];
        }
        if(PRINT_ZIGBEE_INFO) LOG_HEXDUMP_DBG(temp,8,"Extended PAN ID: ");

        switch(zb_get_network_role())
        {
        case 0:
            if(PRINT_ZIGBEE_INFO) LOG_DBG("zigbee role coordinator\n");
            break;
        case 1:
            if(PRINT_ZIGBEE_INFO) LOG_DBG("zigbee role router\n");
            break;
        case 2:
            if(PRINT_ZIGBEE_INFO) LOG_DBG("zigbee role end device\n");
            break;
        default:
            if(PRINT_ZIGBEE_INFO) LOG_DBG("Zigbee role NOT found \n");
            break;
        }

    xbee_parameters.at_ch = zb_get_current_channel();
    if(PRINT_ZIGBEE_INFO) LOG_DBG("zigbee channel: %d \n", xbee_parameters.at_ch);

    }
}


/**
 *
 * @section main_diagram Main Logic Flow
 *
 * @dot
 * digraph main_logic {
 *   node [shape=box, fontname="Arial"];
 *   Main [label="main()"];
 *   DisplaySysInfo [label="display_system_information()"];
 *   DisplayBootStatus [label="display_boot_status()"];
 *   InitNVRAM [label="init_nvram()"];
 *   CheckNVRAM [label="zb_nvram_check_usage()"];
 *   WriteDefaults [label="zb_conf_write_to_nvram()"];
 *   ReadNVRAM [label="zb_conf_read_from_nvram()"];
 *   ZigbeeAPSInit [label="zigbee_aps_init()"];
 *   DigiATInit [label="digi_at_init()"];
 *   NodeDiscoveryInit [label="digi_node_discovery_init()"];
 *   WirelessATInit [label="digi_wireless_at_init()"];
 *   DigiFOTAInit [label="digi_fota_init()"];
 *   ZigbeeBDBInit [label="zigbee_bdb_init()"];
 *   WatchdogInit [label="watchdog_init()"];
 *   UARTInit [label="tcu_uart_init()"];
 *   TimerInit [label="timer1_init()"];
 *   GPIOInit [label="gpio_init()"];
 *   ZigbeeConfig [label="zigbee_configuration()"];
 *   ZigbeeEnable [label="zigbee_enable()"];
 *   SetDataIndCB [label="zb_af_set_data_indication()"];
 *   SetUserDataTxCB [label="zb_aps_set_user_data_tx_cb()"];
 *   ConfirmImage [label="confirm_image()"];
 *   MainLoop [label="while(1)"];
 *   FeedWatchdog [label="periodic_feed_of_main_loop_watchdog()"];
 *   TogglePin [label="diagnostic_toogle_pin()"];
 *   ZigbeeDiag [label="diagnostic_zigbee_info()"];
 *   UARTTranspMgr [label="tcu_uart_transparent_mode_manager()"];
 *   NodeDiscMgr [label="digi_node_discovery_request_manager()"];
 *   WirelessATMgr [label="digi_wireless_read_at_command_manager()"];
 *   DigiFOTAMgr [label="digi_fota_manager()"];
 *   APSMgr [label="zigbee_aps_manager()"];
 *   BDBWatchdog [label="zigbee_bdb_network_watchdog()"];
 *   ZigbeeResetMgr [label="zigbee_reset_manager()"];
 *   NVRAMMgr [label="nvram_manager()"];
 *   UARTMgr [label="tcu_uart_manager()"];
 *   Sleep [label="k_sleep(5ms)"];
 *
 *   Main -> DisplaySysInfo -> DisplayBootStatus -> InitNVRAM -> CheckNVRAM;
 *   CheckNVRAM -> WriteDefaults [label="if unused"];
 *   CheckNVRAM -> ReadNVRAM [label="if used"];
 *   WriteDefaults -> ZigbeeAPSInit;
 *   ReadNVRAM -> ZigbeeAPSInit;
 *   ZigbeeAPSInit -> DigiATInit -> NodeDiscoveryInit -> WirelessATInit -> DigiFOTAInit -> ZigbeeBDBInit -> WatchdogInit -> UARTInit -> TimerInit -> GPIOInit;
 *   GPIOInit -> ZigbeeConfig -> ZigbeeEnable -> SetDataIndCB -> SetUserDataTxCB -> ConfirmImage -> MainLoop;
 *   MainLoop -> FeedWatchdog -> TogglePin -> ZigbeeDiag -> UARTTranspMgr -> NodeDiscMgr -> WirelessATMgr -> DigiFOTAMgr -> APSMgr -> BDBWatchdog -> ZigbeeResetMgr -> NVRAMMgr -> UARTMgr -> Sleep;
 *   Sleep -> MainLoop [style=dotted];
 * }
 * @enddot
 *
 * @section description Description
 * The main logic initializes system information and boot status, then sets up NVRAM.
 * Depending on NVRAM usage, it writes default Zigbee parameters or reads existing ones.
 * It then initializes all Zigbee, UART, watchdog, timer, and GPIO subsystems.
 * After configuration, it enables Zigbee networking, sets up callbacks, and confirms firmware image.
 * The main loop continuously:
 *   - Feeds the watchdog
 *   - Toggles a diagnostic pin
 *   - Prints Zigbee diagnostic info after joining
 *   - Manages UART transparent mode and node discovery
 *   - Handles wireless AT commands and FOTA state machine
 *   - Processes Zigbee APS output queue and BDB network watchdog
 *   - Handles Zigbee and MCU reset requests
 *   - Manages NVRAM and UART
 *   - Sleeps briefly to allow log processing
*
 * @brief Main function of the firmware.
 *
 * Initializes system peripherals and enters the main execution loop.
 * Handles Zigbee network join attempts, application state logic,
 * and watchdog registration.
 *
 * @return int Should never return.
 */
int main(void)
{
    int8_t ret = 0; 

    display_system_information();
    display_boot_status();

    ret = init_nvram();              // Initialize NVRAM
    if( ret != 0)
    {
        LOG_ERR("init_nvram error %d", ret);
        g_b_flash_error = ZB_TRUE;
    }
    
    if (!g_b_flash_error)
    {
        ret = zb_nvram_check_usage();   // Check NVRAM usage

        if( ret == -1) // NVRAM is not used, so write default data
        {
            zb_conf_write_to_nvram(); // Write user configurable zigbee parameters to NVRAM
        }
        else if(ret == 0) // read NVRAM data and use it
        {
            ret = zb_conf_read_from_nvram(); // Read user configurable zigbee parameters from NVRAM
            if(ret < 0)
            {
                LOG_ERR("zb_conf_read_from_nvram error %d", ret);
                //g_b_flash_error = ZB_TRUE;
            }
            else if(ret == 0)
            {
                LOG_INF("NVRAM data read successfully");
                //g_b_flash_error = ZB_FALSE;
            }
        }
        else
        {
            LOG_ERR("zb_nvram_check_usage error %d", ret);
            g_b_flash_error = ZB_TRUE;
        }	
    }

    zigbee_aps_init();
    digi_at_init();
    digi_node_discovery_init();
    digi_wireless_at_init();
    digi_fota_init();
    zigbee_bdb_init();

    ret = watchdog_init();
    if( ret < 0)
    {
        LOG_ERR("watchdog_init error %d", ret);
    }

    ret = tcu_uart_init();
    if( ret < 0)
    {
        LOG_ERR("tcu_uart_init error %d", ret);
    }

    // Initialize TIMER1
    timer1_init();

    // Initialize GPIO
    ret = gpio_init();
    if( ret < 0)
    {
        LOG_ERR("gpio_init error %d", ret);
    }

    LOG_WRN("Starting Zigbee Router");
    zigbee_configuration(); //Zigbee configuration
    zigbee_enable(); // Start Zigbee default thread
    zb_af_set_data_indication(data_indication_cb); // Set call back function for APS frame received
    zb_aps_set_user_data_tx_cb(zigbee_aps_user_data_tx_cb); // Set call back function for APS frame transmitted

    LOG_INF("Router started successfully");

    confirm_image(); // Confirm the image if it is not already confirmed

    while(1)
    {
        periodic_feed_of_main_loop_watchdog();
        diagnostic_toogle_pin();
        diagnostic_zigbee_info();   
        tcu_uart_transparent_mode_manager();     // Manage the frames received from the TCU uart when module is in transparent mode
        digi_node_discovery_request_manager();   // Manage the device discovery requests
        digi_wireless_read_at_command_manager(); // Manage the read AT commands received through Zigbee
        digi_fota_manager();                     // FUOTA state machine
        zigbee_aps_manager();                    // Manage the aps output frame queue
        zigbee_bdb_network_watchdog();           // Network watchdog
        zigbee_reset_manager();                  // Manage reset requests of ZBOSS stack or MCU
        nvram_manager();                         // Manage the NVRAM
        tcu_uart_manager();                      // Manage the TCU UART
        k_sleep(K_MSEC(5));                      // Required to see log messages on console
    }

    return 0;
}
```

## src/Digi_At_commands.h
```c
/*
 * Copyright (c) 2024 IED
 *
 */

#ifndef DIGI_AT_COMMANDS_H_
#define DIGI_AT_COMMANDS_H_

#include "global_defines.h"

#define MINIMUM_SIZE_AT_COMMAND 4
#define MAXIMUM_SIZE_AT_COMMAND 4 + 1 + SIZE_LINK_KEY + SIZE_LINK_KEY //Write command + blank + link key (two characters per byte)

#define HARDCODED_ATJV_VALUE 1      // Coordinator join verification (0 = disabled, 1 = enabled) JV = true is compatible with the current firmware
#define HARDCODED_ATNJ_VALUE 0xFF   // Node join time (0xFF = disabled, 0x00 = enabled) NJ = 0xFF is compatible with the current firmware
#define HARDCODED_ATNW_VALUE 10     // Network watchdog (Valid range is [0, 0x64FF]) NW = 10 is compatible with the current firmware
#define HARDCODED_ATCE_VALUE 0      // Coordinator enabled (0 = disabled, 1 = enabled) CE = false is compatible with the current firmware
#define HARDCODED_ATAI_VALUE 0xFF   // Association indication (0xFF = disabled, 0x00 = enabled) AI = 0xFF is compatible with the current firmware
#define INITIAL_ATCH_VALUE 0x0C     // Initial value for the operation channel (CH) (0x0C = 12) CH = 12 is compatible with the current firmware
#define INITIAL_ATMY_VALUE 0x0000   // Initial value for the short address (MY) (0x0000 = 0) MY = 0 is compatible with the current firmware
#define HARDCODED_ATEE_VALUE 1        // Default value for the encryption enable (EE) (0 = disabled, 1 = enabled) EE = true is compatible with the current firmware
#define HARDCODED_ATEO_VALUE 0        // Default value for the encryption options (EO) (0 = disabled, 1 = enabled) EO = false is compatible with the current firmware
#define HARDCODED_ATZS_VALUE 2      // Default value for the Zigbee stack profile (ZS) (2 = ZigBee-PRO) ZS = 2 is compatible with the current firmware
#define HARDCODED_ATBD_VALUE 4      // Default value for the UART baud rate (BD) (4 = 19200 bps) BD = 4 is compatible with the current firmware
#define HARDCODED_ATNB_VALUE 0      // Default value for the UART parity (NB) (0 = None) NB = 0 is compatible with the current firmware

/* Enumerative with the supported Xbee AT commands used to read/write parameters */
enum parameter_at_command_e{
    AT_VR, // Read the Xbee's FW version
    AT_HV, // Read the Xbee's HW version
    AT_SH, // Read the high part of the MAC address
    AT_SL, // Read the low part of the MAC address
    AT_JV, // Read / write the "coordinator join verification" parameter [JV]
    AT_NJ, // Read / write the "node join time" parameter [NJ]
    AT_NW, // Read / write the "network watchdog" parameter [NW]
    AT_ID, // Read / write the "extended pan id" parameter [ID]
    AT_NI, // Read / write the "node identifier string" parameter [NI]
    AT_CE, // Read / write the "coordinator enabled" parameter [CE]
    AT_AI, // Read the "association indication" parameter [AI]
    AT_CH, // Read the "operation channel" parameter [CH]
    AT_MY, // Read the "short address" parameter [MY]
    AT_EE, // Read / write the "encryption enable" parameter [EE]
    AT_EO, // Read / write the "encryption options" parameter [EO]
    AT_KY, // Read / write the "link encryption key" parameter [KY]
    AT_ZS, // Read / write the "Zigbee stack profile" parameter [ZS]
    AT_BD, // Read / write the "baud rate" parameter [BD]
    AT_NB, // Read / write the "parity" parameter [BD]
    AT_AC, // Apply changes and leave command mode
    AT_WR, // Write in flash memory and leave command mode
    AT_CN, // Leave command mode
    AT_NR, // Reset the Xbee
    NUMBER_OF_PARAMETER_AT_COMMANDS
};

/* Enumerative with the error codes generated when analyzing an AT command    */
enum at_command_analysis_error_code_e{
    AT_CMD_ERROR_TOO_SHORT = -6,
    AT_CMD_ERROR_TOO_LONG = -5,
    AT_CMD_ERROR_WRONG_PREFIX = -4,
    AT_CMD_ERROR_NOT_SUPPORTED_READ_CMD = -3,
    AT_CMD_ERROR_WRITE_DATA_NOT_VALID = -2,
    AT_CMD_ERROR_NOT_SUPPORTED_WRITE_CMD = -1,
    AT_CMD_OK_STAY_IN_CMD_MODE = 0,
    AT_CMD_OK_LEAVE_CMD_MODE = 1
};

/* Xbee parameters                                                            */
struct xbee_parameters_t {
    uint16_t at_vr; // Xbee's FW version (read only)
    uint16_t at_hv; // Xbee's HW version (read only)
    uint32_t at_sh; // High part of the MAC address (read only)
    uint32_t at_sl; // Low part of the MAC address (read only)
    uint8_t at_jv;  // Coordinator join verification parameter
    uint8_t at_nj;  // Node join time parameter
    uint16_t at_nw; // Network watchdog parameter
    uint64_t at_id; // Extended pan id parameter
    uint8_t at_ce;   // Coordinator enabled parameter
    uint8_t at_ai;   // Association indication parameter (read only)
    uint8_t at_ch;   // Operation channel parameter (read only)
    uint16_t at_my;   // Short address parameter (read only)
    uint8_t at_ee;   // Encryption enable parameter
    uint8_t at_eo;   // Encryption options parameter
    uint8_t at_ky[SIZE_LINK_KEY];   // Link Encryption Key parameter
    uint8_t at_zs;   // Xbee's Zigbee stack profile parameter
    uint8_t at_bd;   // Xbee's UART baud rate parameter
    uint8_t at_nb;   // Xbee's UART parity parameter
    uint8_t at_ni[MAXIMUM_SIZE_NODE_IDENTIFIER + 1];   // Node identifier string parameter (plus one to include the '\0')
};

/* Function prototypes used only internally                                   */
void digi_at_init_xbee_parameters(void);
void digi_at_init_xbee_parameter_command(void);
int8_t digi_at_read_ni(uint8_t* buffer);
int8_t digi_at_read_ky(uint8_t* buffer);
void digi_at_reply_read_command(uint8_t at_command);
void digi_at_reply_action_command(uint8_t at_command);
bool digi_at_reply_write_command(uint8_t at_command, const char *command_data_string, uint8_t string_size);
bool convert_hex_string_to_uint64(const char *hex_string, uint8_t string_size, uint64_t *output_result);
void ascii_to_hex(const char *ascii, uint8_t *hex, size_t hex_len);


/* Function prototypes used externally                                        */
void digi_at_init(void);
void digi_at_reply_ok(void);
void digi_at_reply_error(void);
int8_t digi_at_analyze_and_reply_to_command(uint8_t *input_data, uint16_t size_input_data);
uint64_t digi_at_get_parameter_id(void);
uint16_t digi_at_get_parameter_vr(void);
void digi_at_get_parameter_ni(uint8_t *ni);
void digi_at_get_parameter_ky(uint8_t *ky);

#endif /* DIGI_AT_COMMANDS_H_ */
```

## src/Digi_fota.h
```c
/*
 * Copyright (c) 2025 IED
 *
 */

#ifndef DIGI_FOTA_H_
#define DIGI_FOTA_H_

#include "global_defines.h"

#define DIGI_FILE_HEADER_SIZE 62      // DIGI .ota files include a 62-byte header before the binary file contents
#define FILE_BLOCK_MAX_SIZE 47        // With this size, a file fragment can be transmitted in a single Zigbee packet

// FUOTA SERVER COMMANDS
#define IMAGE_NOTIFY_CMD               0x00
#define QUERY_NEXT_IMAGE_RESPONSE_CMD  0x02
#define IMAGE_BLOCK_RESPONSE_CMD       0x05
#define UPGRADE_END_RESPONSE_CMD       0x07

// FUOTA CLIENT COMMANDS
#define QUERY_NEXT_IMAGE_REQUEST_CMD   0x01
#define IMAGE_BLOCK_REQUEST_CMD        0x03
#define UPGRADE_END_REQUEST_CMD        0x06

// FUOTA SERVER AND CLIENT COMMANDS
#define DEFAULT_RESPONSE_CMD           0x0B

// FUOTA SERVER COMMAND STATUS CODES
#define FOTA_STATUS_SUCCESS 0x00
#define FOTA_STATUS_NO_IMAGE_AVAILABLE 0x98
#define FOTA_STATUS_NOT_AUTHORIZED 0x7E

// SIZE OF FUOTA SERVER COMMANDS
#define IMAGE_NOTIFY_CMD_SIZE               13
#define QUERY_NEXT_IMAGE_RESPONSE_CMD_SIZE  16
#define IMAGE_BLOCK_RESPONSE_HEADER_SIZE    17
#define IMAGE_BLOCK_RESPONSE_CMD_SIZE_MIN   IMAGE_BLOCK_RESPONSE_HEADER_SIZE + 1
#define IMAGE_BLOCK_RESPONSE_CMD_SIZE_MAX   IMAGE_BLOCK_RESPONSE_HEADER_SIZE + FILE_BLOCK_MAX_SIZE
#define UPGRADE_END_RESPONSE_CMD_SIZE       19
#define DEFAULT_RESPONSE_CMD_SIZE           5


#define DIGI_MANUFACTURER_ID 0x101E   // DIGI manufacturer code
#define DIGI_IMAGE_TYPE      0x0001   // DIGI's manufacturer specific image type
#define FRAME_CONTROL_FIELD_CLUSTER_SPECIFIC_CLIENT_TO_SERVER 0x01
#define FIELD_CONTROL_HW_VERSION_NO_PRESENT                   0x01

#define MAX_NEXT_IMAGE_CMD_RESPONSE_TIME_MS     10000 // Maximum duration the client will wait for a response to this command
#define MAX_IMAGE_BLOCK_CMD_RESPONSE_TIME_MS    5000 // Maximum duration the client will wait for a response to this command
#define MAX_UPGRADE_CMD_RESPONSE_TIME_MS        10000 // Maximum duration the client will wait for a response to this command

#define MAX_ATTEMPTS_DFU_INIT                3  // FUOTA process is canceled after 3 unsuccessful DFU initialization attempts
#define MAX_ATTEMPTS_NEXT_IMAGE_REQUEST      3  // FUOTA process is canceled after 3 unanswered Next Image requests
#define MAX_ATTEMPTS_IMAGE_BLOCK_REQUEST     10  // FUOTA process is canceled after 10 unanswered Image Block requests
#define MAX_ATTEMPTS_UPGRADE_END_REQUEST     3  // FUOTA process is canceled after 3 unanswered Upgrade and End requests

#define DFU_INIT_ATTEMPT_DELAY_MS           2000 // Delay between attempts to initialize the DFU target (2 seconds)
#define IMAGE_BLOCK_REQUEST_DELAY_MS        200 // Delay between attempts to request the next image block (200 milliseconds)

struct firmware_image_t {
    uint16_t manufacturer_code;
    uint16_t image_type;
    uint32_t firmware_version;
    uint32_t file_size;
};

/* Enumerative with the FUOTA state machine states */
enum fuota_state_machine_e{
    FUOTA_INIT_STATE_ST,
    FUOTA_UPGRADE_WAS_INTERRUPTED_ST,
    FUOTA_WAITING_FOR_IMAGE_NOTIFY_ST,
    FUOTA_IMAGE_NOTIFY_RECEIVED_ST,
    FUOTA_MAKE_NEXT_IMAGE_REQUEST_ST,
    FUOTA_WAITING_FOR_NEXT_IMAGE_RESPONSE_ST,
    FUOTA_NEXT_IMAGE_RESPONDED_ST,
    FUOTA_INIT_DFU_TARGET,
    FUOTA_MAKE_NEW_IMAGE_BLOCK_REQUEST_ST,
    FUOTA_WAITING_FOR_IMAGE_BLOCK_RESPONSE_ST,
    FUOTA_IMAGE_BLOCK_RESPONDED_ST,
    FUOTA_MAKE_AN_UPGRADE_END_REQUEST_ST,
    FUOTA_WAITING_FOR_UPGRADE_END_RESPONSE_ST,
    FUOTA_UPGRADE_END_RESPONDED_ST,
    FUOTA_NUMBER_OF_STATES
};

/* Function prototypes used only internally                                   */
bool process_image_notify_cmd(uint8_t* input_data, int16_t size_of_input_data);
bool process_next_image_response_cmd(uint8_t* input_data, int16_t size_of_input_data);
bool process_image_block_response_cmd(uint8_t* input_data, int16_t size_of_input_data);
bool process_upgrade_end_response_cmd(uint8_t* input_data, int16_t size_of_input_data);
bool process_default_response_cmd(uint8_t* input_data, int16_t size_of_input_data);
bool digi_fota_send_query_next_image_request_cmd(void);
bool digi_fota_send_image_block_request_cmd(void);
bool digi_fota_send_upgrade_end_request_cmd(void);
void digi_fota_switch_state(enum fuota_state_machine_e new_state);
void set_in_nvram_fota_is_active(void);
void set_in_nvram_fota_is_not_active(void);
bool read_from_nvram_if_fota_was_interrupted(void);

/* Function prototypes used externally                                        */
void digi_fota_init(void);
bool is_a_digi_fota_command(uint8_t* input_data, int16_t size_of_input_data);
void digi_fota_manager(void);

#endif /* DIGI_FOTA_H_ */
```

## src/Digi_node_discovery.c
```c
/*
 * Copyright (c) 2024 IED
 *
 */

/** @file
 *
 * @brief Managment of replies to the Node Discovery command from Digi.
 */



#include <zephyr/kernel.h>
#include <zephyr/logging/log.h>

#include <zboss_api.h>

#include "Digi_profile.h"
#include "zigbee_aps.h"
#include "Digi_At_commands.h"
#include "Digi_node_discovery.h"
#include "zigbee_configuration.h"

/* Local variables                                                            */
static struct node_discovery_reply_t node_discovery_reply;

LOG_MODULE_REGISTER(Digi_node_discovery, LOG_LEVEL_DBG);

/**
 * @brief Digi Node Discovery Module
 *
 * This module manages replies to Digi/XBee Node Discovery (ND) commands over Zigbee APS frames.
 * It detects incoming ND requests, schedules randomized replies, and formats responses
 * compatible with Digi/XBee expectations.
 *
 * @dot
 * digraph DigiNodeDiscovery {
 *     rankdir=LR;
 *     node [shape=box];
 *
 *     APS_RX [label="APS RX: Receive Zigbee frame"];
 *     CheckND [label="is_a_digi_node_discovery_request()"];
 *     Pending [label="Set pending request\nand reply timing"];
 *     MainLoop [label="digi_node_discovery_request_manager()"];
 *     TimeCheck [label="Check if reply time reached"];
 *     Reply [label="digi_node_discovery_reply()"];
 *     Format [label="Format ND reply payload"];
 *     Enqueue [label="enqueue_aps_frame()"];
 *     Done [label="Reply sent"];
 *
 *     APS_RX -> CheckND;
 *     CheckND -> Pending [label="ND request detected"];
 *     Pending -> MainLoop;
 *     MainLoop -> TimeCheck;
 *     TimeCheck -> Reply [label="Time to reply"];
 *     Reply -> Format;
 *     Format -> Enqueue;
 *     Enqueue -> Done;
 * }
 * @enddot
 *
 * Flow:
 * 1. APS RX receives a Zigbee frame.
 * 2. is_a_digi_node_discovery_request() checks if it's an ND command.
 * 3. If ND, sets pending request and schedules a randomized reply time.
 * 4. Periodically, digi_node_discovery_request_manager() checks if it's time to reply.
 * 5. When due, digi_node_discovery_reply() formats the ND reply payload (including addresses, NI string, etc.).
 * 6. The reply is enqueued for Zigbee transmission.
 *
 * Key Features:
 * - Compatible with Digi/XBee ND command format.
 * - Randomized reply timing to avoid reply collisions.
 * - Includes device addressing, node identifier, and product/manufacturer info in reply.
 * - Designed for integration with Zephyr and ZBOSS Zigbee stack.
 */

/**
 * @brief This function initializes the Node Discovery module
 *
 * @details This function initializes the Node Discovery module by setting the initial values
 *          for the node discovery reply structure.
 */
void digi_node_discovery_init(void)
{
    node_discovery_reply.b_pending_request = false;
    node_discovery_reply.first_character = 0;
    node_discovery_reply.max_reply_time_ms = 0;
    node_discovery_reply.time_request_ms = 0;
    node_discovery_reply.time_reply_ms = 0;

    zb_conf_get_extended_node_identifier(node_discovery_reply.at_ni);

}

/**
 * @brief This function evaluates if the last received APS frame is a Digi's Node Discover request
 *
 * @param[in]   input_data   Pointer to payload of received APS frame
 * @param[in]   size_of_input_data   Payload size
 *
 * @retval True It is a Digi's Node Discover request
 * @retval False Otherwise
 */
bool is_a_digi_node_discovery_request(uint8_t* input_data, int16_t size_of_input_data)
{
    bool b_return = false;
    LOG_WRN("is_a_digi_node_discovery_request, size %d", size_of_input_data);
    LOG_HEXDUMP_WRN(input_data, size_of_input_data, "APS frame payload");
    if( size_of_input_data >= 12 ) // TODO. I don't know if the size of this frame is constant. I know it should have at least 12 chars
    {
        if( ( input_data[10] == 'N' ) && ( input_data[11] == 'D' ) ) // ND command
        {
            if( input_data[1] >= 32 ) // Minimum valid discovery timeout
            {
                LOG_WRN("Node Discovery request received");
                b_return = true;
                node_discovery_reply.b_pending_request = true;
                node_discovery_reply.first_character = input_data[0];
                node_discovery_reply.max_reply_time_ms = (input_data[1] + 10) * 100;
                node_discovery_reply.time_request_ms = k_uptime_get();
                node_discovery_reply.time_reply_ms = node_discovery_reply.time_request_ms + node_discovery_reply.max_reply_time_ms/2; //TODO. It should be random, so not all TSC reply at the same time
            }
        }
    }
    return b_return;
}

/**
 * @brief This function places in the APS output frame queue the reply to a node discovery request.
*
* @details It formats the reply according to Digi's Node Discovery request format.
*          The reply includes the node's short address, long address, node identifier, parent address,
*          node type, profile ID, manufacturer ID, product type, and a fixed RSSI value.
*
* @retval True if the reply was successfully enqueued
* @retval False if there was no free space in the APS output frame queue
*/
bool digi_node_discovery_reply(void)
{
    bool b_return = false;
    
    if( zigbee_aps_get_output_frame_buffer_free_space() )
    {
        uint8_t i,j;
        aps_output_frame_t element;
        zb_ieee_addr_t zb_long_address; // MAC address of this node

        element.dst_addr.addr_short = COORDINATOR_SHORT_ADDRESS;
        element.profile_id = DIGI_PROFILE_ID;
        element.cluster_id = DIGI_COMMISSIONING_REPLY_CLUSTER;
        element.src_endpoint = DIGI_COMMISSIONING_SOURCE_ENDPOINT;
        element.dst_endpoint = DIGI_COMMISSIONING_DESTINATION_ENDPOINT;
        i = 0;
        element.payload[i++] = (zb_uint8_t)node_discovery_reply.first_character; //First character of the Node Discovery request
        element.payload[i++] = 'N'; //ND, node discovery
        element.payload[i++] = 'D';
        element.payload[i++] = 0;
        element.payload[i++] = (zb_uint8_t)((uint16_t)(zb_get_short_address())>>8); //Short address, high byte
        element.payload[i++] = (zb_uint8_t)(zb_get_short_address());//Short address, low byte

        zb_get_long_address(zb_long_address); //MAC address of device
        for(j = 0; j<8; j++)
        {
            element.payload[i++] = zb_long_address[7-j];
        }       
        j = 0;
        while(j < 32)
        {
            if( node_discovery_reply.at_ni[j] == 0 ) break; //Null character found
            else
            {
                element.payload[i++] = node_discovery_reply.at_ni[j]; //Node identifier string
                j++;
            }
        }
        element.payload[i++] = 0;
        element.payload[i++] = 0xFF; //Parent address of node (always 0xFFFE for routers)
        element.payload[i++] = 0xFE;
        element.payload[i++] = 0x01; // Node type = 1 (router)
        element.payload[i++] = 0;
        element.payload[i++] = 0xC1; // Profile ID = 0xC105;
        element.payload[i++] = 0x05;
        element.payload[i++] = 0x10; // Manufacturer ID = 0x101E (We will start using a value from DIGI's Xbees)
        element.payload[i++] = 0x1E;
        element.payload[i++] = ((uint32_t)(PRODUCT_TYPE) >> 24) & 0xFF; // Product type
        element.payload[i++] = ((uint32_t)(PRODUCT_TYPE) >> 16) & 0xFF;
        element.payload[i++] = ((uint32_t)(PRODUCT_TYPE) >> 8) & 0xFF;
        element.payload[i++] = (uint32_t)(PRODUCT_TYPE) & 0xFF;
        element.payload[i++] = ((uint16_t)(MANUFACTURED_ID) >> 8) & 0xFF; // Manufactured ID
        element.payload[i++] = (uint16_t)(MANUFACTURED_ID) & 0xFF;
        element.payload[i++] = 0x2e; // TODO. Not sure what it means. It represents the RSSI or a related magnitude.
        element.payload_size = (zb_uint8_t)i;
        LOG_WRN("Node Discovery reply");
        LOG_HEXDUMP_DBG(element.payload, element.payload_size, "Node Discovery reply payload");
        if( enqueue_aps_frame(&element) ) b_return = true;
    }

    if( !b_return ) LOG_ERR("Not free space of aps output frame queue");

    return b_return;
}

/**
 * @brief Checks if there is a pending node discovery request and schedules the reply if needed.
 *
 * @details This function should be called periodically in the main loop.
 *          It checks if there is a pending node discovery request and if the time to reply has passed.
 */
void digi_node_discovery_request_manager(void)
{
    if( node_discovery_reply.b_pending_request )
    {
        uint64_t time_now_ms = k_uptime_get();
        if( time_now_ms >= node_discovery_reply.time_reply_ms )
        {
            node_discovery_reply.b_pending_request = false;
            digi_node_discovery_reply();
        }
    }
}
```

## src/Digi_node_discovery.h
```c
/*
 * Copyright (c) 2024 IED
 *
 */

#ifndef DIGI_NODE_DISCOVERY_H_
#define DIGI_NODE_DISCOVERY_H_

#define DIGI_NODE_DISCOVERY_REPLY_PAYLOAD_SIZE_MAX 60 //Considering that maximum size of node identifier is 32 chars

struct node_discovery_reply_t {
    bool    b_pending_request; // There is a pending node discovery request
    uint8_t first_character; // First character of the last node discovery request
    uint16_t max_reply_time_ms; // Maximum allowed time for sending response to the discovery request
    uint64_t time_request_ms; // Time at which the node discovery request was received
    uint64_t time_reply_ms; // Time at which the node discovery request will be replied.
    uint8_t at_ni[MAXIMUM_SIZE_NODE_IDENTIFIER+1];   // Node identifier string parameter
};

/* Function prototypes                                                        */
void digi_node_discovery_init(void);
bool is_a_digi_node_discovery_request(uint8_t* input_data, int16_t size_of_input_data);
bool is_a_hv_info_request(uint8_t* input_data, int16_t size_of_input_data);
bool digi_node_discovery_reply(void);
void digi_node_discovery_request_manager(void);

#endif /* DIGI_NODE_DISCOVERY_H_ */
```

## src/Digi_profile.h
```c
/*
 * Copyright (c) 2024 IED
 *
 */

#ifndef DIGI_PROFILE_H_
#define DIGI_PROFILE_H_

#define DIGI_PROFILE_ID 0xC105

#define DIGI_BINARY_VALUE_CLUSTER 0x0011
#define DIGI_BINARY_VALUE_SOURCE_ENDPOINT 232
#define DIGI_BINARY_VALUE_DESTINATION_ENDPOINT 232

#define DIGI_COMMISSIONING_CLUSTER 0x0015
#define DIGI_COMMISSIONING_REPLY_CLUSTER 0x0095
#define DIGI_COMMISSIONING_SOURCE_ENDPOINT 230
#define DIGI_COMMISSIONING_DESTINATION_ENDPOINT 230

#define DIGI_AT_COMMAND_CLUSTER 0x0021
#define DIGI_AT_COMMAND_REPLY_CLUSTER 0x00A1
#define DIGI_AT_COMMAND_SOURCE_ENDPOINT 230
#define DIGI_AT_COMMAND_DESTINATION_ENDPOINT 230

#define DIGI_AT_PING_CLUSTER 0x0012
#define DIGI_AT_PING_SOURCE_ENDPOINT 219
#define DIGI_AT_PING_DESTINATION_ENDPOINT 232

#define DIGI_AT_PONG_CLUSTER 0x0011
#define DIGI_AT_PONG_SOURCE_ENDPOINT 232
#define DIGI_AT_PONG_DESTINATION_ENDPOINT 219

#define DIGI_FOTA_CLUSTER 0x0019


#define PRODUCT_TYPE     0x00000001 // I will assign that value as product type of the Fanstel BT840E
#define MANUFACTURED_ID  0x0001     // I will assign that value as manufactured ID of the Fanstel BT840E


#endif /* DIGI_PROFILE_H_ */
```

## src/Digi_wireless_at_commands.h
```c
/*
 * Copyright (c) 2025 IED
 *
 */

#ifndef DIGI_WIRELESS_AT_COMMANDS_H_
#define DIGI_WIRELESS_AT_COMMANDS_H_

#include "global_defines.h"

#define MAX_SIZE_AT_COMMAND_REPLY MAXIMUM_SIZE_NODE_IDENTIFIER

/* Enumerative with the supported Xbee wireless AT commands used to read parameters */
enum wireless_at_read_cmd_e{
    EXT_READ_AT_AI, // Read Association indication (AI)
    EXT_READ_AT_AR, // Read Aggregation route notification (AR)
    EXT_READ_AT_BD, // Read Serial interface data rate (BD)
    EXT_READ_AT_BH, // Read Broadcast radius (BH)
    EXT_READ_AT_CC, // Read Command sequence character (CC)
    EXT_READ_AT_CE, // Read Coordinator enable (CE) 
    EXT_READ_AT_CH, // Read Operating channel (CH) 
    EXT_READ_AT_CI, // Read Cluster identifier (CI)   
    EXT_READ_AT_CR, // Read PAN conflict threshold (CR) 
    EXT_READ_AT_CT, // Read Command mode timeout (CT) 
    EXT_READ_AT_D0, // Read AD0/DIO0 configuration (D0) 
    EXT_READ_AT_D1, // Read AD1/DIO1 configuration (D1) 
    EXT_READ_AT_D2, // Read AD2/DIO2 configuration (D2) 
    EXT_READ_AT_D3, // Read AD3/DIO3 configuration (D3) 
    EXT_READ_AT_D4, // Read AD4/DIO4 configuration (D4) 
    EXT_READ_AT_D5, // Read DIO5/Assoc configuration (D5) 
    EXT_READ_AT_D6, // Read DIO6 configuration (D6) 
    EXT_READ_AT_D7, // Read DIO7 configuration (D7) 
    EXT_READ_AT_D8, // Read DIO8/SleepRQ configuration (D8) 
    EXT_READ_AT_D9, // Read DIO9/ON_SLEEP configuration (D9) 
    EXT_READ_AT_DB, // Read Received signal strength (DB) 
    EXT_READ_AT_DD, // Read Device type identifier (DD)
    EXT_READ_AT_DE, // Read Destination endpoint (DE)
    EXT_READ_AT_DH, // Read Destination address (DH)
    EXT_READ_AT_DL, // Read Destination address (DL)
    EXT_READ_AT_EA, // Read ACK failures (EA)
    EXT_READ_AT_EE, // Read Encryption enable (EE)
    EXT_READ_AT_EO, // Read Encryption options (EO)
    EXT_READ_AT_GT, // Read Guard times (GT)
    EXT_READ_AT_HV, // Read Hardware version (HV)
    EXT_READ_AT_IC, // Read DIO change detect (IC)
    EXT_READ_AT_ID, // Read Extended PAN identifier (ID)
    EXT_READ_AT_II, // Read Initial PAN identifier (II)
    EXT_READ_AT_IR, // Read I/O sample rate (IR)
    EXT_READ_AT_JN, // Read Join notification (JN)
    EXT_READ_AT_JV, // Read Join verification (JV)
    EXT_READ_AT_KY, // Read Link encryption key (KY)
    EXT_READ_AT_LT, // Read Associate LED blink time (LT)
    EXT_READ_AT_MP, // Read Parent address (MP)
    EXT_READ_AT_MY, // Read Network address (MY)
    EXT_READ_AT_NB, // Read Serial interface parity (NB)
    EXT_READ_AT_NC, // Read Number of remaining children (NC)
    EXT_READ_AT_NH, // Read Maximum hops (NH)
    EXT_READ_AT_NI, // Read Node identifier (NI)
    EXT_READ_AT_NJ, // Read Node join time (NJ)
    EXT_READ_AT_NK, // Read Network encryption key (NK)
    EXT_READ_AT_NP, // Read Maximum RF payload (NP)
    EXT_READ_AT_NT, // Read Node discovery timeout (NT)
    EXT_READ_AT_NW, // Read Network watchdog timeout (NW)
    EXT_READ_AT_OI, // Read PAN identifier (OI)
    EXT_READ_AT_OP, // Read Extended PAN identifier (OP)
    EXT_READ_AT_P2, // Read DIO12/CD configuration (P2)
    EXT_READ_AT_P3, // Read DIO13/DOUT configuration (P3)
    EXT_READ_AT_P4, // Read DIO14/DIN configuration (P4)
    EXT_READ_AT_P5, // Read DIO15 configuration (P5)
    EXT_READ_AT_P6, // Read DIO16 configuration (P6)
    EXT_READ_AT_P7, // Read DIO17 configuration (P7)
    EXT_READ_AT_P8, // Read DIO18 configuration (P8)
    EXT_READ_AT_P9, // Read DIO19 configuration (P9)
    EXT_READ_AT_PD, // Read Pull-up/down direction (PD)   
    EXT_READ_AT_PL, // Read Transmit power level (PL)
    EXT_READ_AT_PO, // Read Read Polling rate (PO)
    EXT_READ_AT_PP, // Read Transmit power at PL4 (PP)
    EXT_READ_AT_PR, // Read Pull-up resistor enable (PR)
    EXT_READ_AT_RO, // Read Packetization timeout (RO)
    EXT_READ_AT_SB, // Read Stop bits (SB)
    EXT_READ_AT_SC, // Read Scan channels (SC)
    EXT_READ_AT_SD, // Read Scan duration (SD)
    EXT_READ_AT_SE, // Read Source endpoint (SE)
    EXT_READ_AT_SM, // Read Sleep mode (SM)
    EXT_READ_AT_SN, // Read Peripheral sleep count (SN)
    EXT_READ_AT_SO, // Read Sleep options (SO)
    EXT_READ_AT_SP, // Read Cyclic sleep period (SP)
    EXT_READ_AT_ST, // Read Time before sleep (ST)
    EXT_READ_AT_TP, // Read Temperature (TP)
    EXT_READ_AT_Vplus, // Read Supply voltage high threshold (V+)
    EXT_READ_AT_VR, // Read Firmware version (VR)
    EXT_READ_AT_WH, // Read Wake host delay (WH)
    EXT_READ_AT_ZS, // Read ZigBee stack profile (ZS)
    EXT_READ_AT_percV, // Read Supply voltage (%V)
    NUMBER_OF_WIRELESS_AT_READ_COMMANDS,
    NO_SUPPORTED_EXT_READ_AT_CMD
};

void digi_wireless_at_init(void);
bool is_a_ping_command(uint8_t* input_data, int16_t size_of_input_data);
bool is_a_digi_read_at_command(uint8_t* input_data, int16_t size_of_input_data);
void digi_wireless_read_at_command_manager(void);
bool digi_wireless_read_at_cmd_reply(void);
bool digi_wireless_ping_reply(void);

#endif /* DIGI_WIRELESS_AT_COMMANDS_H_ */
```

## src/OTA_dfu_target.c
```c
/*
 * Copyright (c) 2025 IED
 *
 */

/** @file
 *
 * @brief   Management of the OTA DFU target for firmware updates.
 */

#include <zephyr/kernel.h>
#include <zephyr/logging/log.h>

#include <zephyr/dfu/mcuboot.h>
#include <zephyr/kernel.h>
#include <dfu/dfu_target.h>
#include <dfu/dfu_target_mcuboot.h>
#include <zephyr/sys/reboot.h>
#include <zephyr/storage/flash_map.h>

#include "Digi_profile.h"
#include "OTA_dfu_target.h"

LOG_MODULE_REGISTER(OTA_dfu_target, LOG_LEVEL_INF);

#define STAGING_BUF_SIZE 512                                // Size of the staging buffer for dfu target mcuboot 
static uint8_t staging_buf[STAGING_BUF_SIZE] __aligned(32); // The array should be aligned to 32 bits,
static uint8_t dfu_target_initialized = false;

/**@brief Check that there is a partition available in flash for storing the new image.
 *
 * @retval 0 If successful, negative error code otherwise.
 */
int_fast8_t check_flash_area(void)
{
    const struct flash_area *fa;
    int rc = flash_area_open(FLASH_AREA_ID(image_1), &fa);

    if (rc != OTA_DFU_TARGET_OK)
    {
        LOG_ERR("image_1 not found in flash map! Error: %d", rc);
    } 
    else 
    {
        LOG_INF("image_1 offset: 0x%lx, size: %d", fa->fa_off, fa->fa_size);
        flash_area_close(fa);
    }
    return rc;
}

/**@brief Initialization of dfu target
 *
 * @param[in] file_size of the file is getting downloaded.
 *
 * @retval 0 If successful, negative error code otherwise.
 */
int OTA_dfu_target_init(size_t file_size)
{
    int ret;
    size_t initial_offset;

    if (dfu_target_initialized)
    {
        dfu_target_mcuboot_done(false); // Cancel and release resources
        dfu_target_initialized = false;
    }

    ret = check_flash_area();
    if (ret != OTA_DFU_TARGET_OK)
    {
        LOG_ERR("check_flash_area() failed: %d", ret);
        return OTA_DFU_TARGET_ERR_FLASH_AREA;
    }
    ret = dfu_target_mcuboot_set_buf(staging_buf, STAGING_BUF_SIZE);
    if (ret != OTA_DFU_TARGET_OK)
    {
        LOG_ERR("dfu_target_mcuboot_set_buf() failed: %d", ret);
        return OTA_DFU_TARGET_SET_BUF_ERR; 
    }
    ret = dfu_target_mcuboot_init(file_size, 0, NULL);
    if (ret != OTA_DFU_TARGET_OK)
    {
        LOG_ERR("dfu_target_mcuboot_init() failed: %d", ret);
        return OTA_DFU_TARGET_ERR_INIT;
    }
    dfu_target_initialized = true;
    ret = dfu_target_mcuboot_reset();
    if (ret != OTA_DFU_TARGET_OK)
    {
        LOG_ERR("dfu_target_mcuboot_reset() failed: %d", ret);
        dfu_target_mcuboot_done(false); // Cancel upgrade and release resources
        dfu_target_initialized = false;
        return OTA_DFU_TARGET_RESET_ERR; 
    }
    ret = dfu_target_mcuboot_offset_get(&initial_offset);
    if (ret != OTA_DFU_TARGET_OK)
    {
        LOG_ERR("dfu_target_mcuboot_offset_get() failed: %d", ret);
        dfu_target_mcuboot_done(false); // Cancel upgrade and release resources
        dfu_target_initialized = false;
        return OTA_DFU_TARGET_OFFSET_ERR;
    }
    {
        LOG_ERR("dfu_target_mcuboot_offset_get() failed: %d", ret);
        dfu_target_mcuboot_done(false); // Cancel upgrade and release resources
        dfu_target_initialized = false;
        return OTA_DFU_TARGET_OFFSET_ERR;
    }
    if (initial_offset != 0)
    {
        LOG_ERR("The initial dfu target offset is not 0");
        dfu_target_mcuboot_done(false); // Cancel upgrade and release resources
        dfu_target_initialized = false;
        return OTA_DFU_TARGET_ERR_WRITE;
    }
    return OTA_DFU_TARGET_OK;
}

/**@brief Initialization of dfu target when we think that there was fuota upgrade process already started
 *
 * @param[in] file_size of the file is getting downloaded.
 *
 * @retval Offset of the already started fuota upgrade process. 0 if the initialization process did not success.
 */
uint32_t OTA_dfu_target_init_resume_previous_upgrade(size_t file_size)
{
    int ret;
    size_t initial_offset;

    ret = check_flash_area();
    if (ret != OTA_DFU_TARGET_OK)
    {
        LOG_ERR("check_flash_area() failed: %d", ret);
        return OTA_DFU_TARGET_OK;
    }
    ret = dfu_target_mcuboot_set_buf(staging_buf, STAGING_BUF_SIZE);
    if (ret != OTA_DFU_TARGET_OK)
    {
        LOG_ERR("dfu_target_mcuboot_set_buf() failed: %d", ret);
        return OTA_DFU_TARGET_OK;
    }
    ret = dfu_target_mcuboot_init(file_size, 0, NULL);
    if (ret != OTA_DFU_TARGET_OK)
    {
        LOG_ERR("dfu_target_mcuboot_init() failed: %d", ret);
        return OTA_DFU_TARGET_OK;
    }
    dfu_target_initialized = true;
    ret = dfu_target_mcuboot_offset_get(&initial_offset);
    if (ret != OTA_DFU_TARGET_OK)
    {
        LOG_ERR("dfu_target_mcuboot_offset_get() failed: %d", ret);
        dfu_target_mcuboot_done(false); // Cancel upgrade and release resources
        dfu_target_initialized = false;
        return OTA_DFU_TARGET_OK;
    }
    if (initial_offset > 0)
    {
        LOG_WRN("There was a previous FW upgrade in process");
        return (uint32_t)initial_offset;
    }
    dfu_target_mcuboot_done(false); // Cancel upgrade and release resources
    dfu_target_initialized = false;
    return OTA_DFU_TARGET_OK;
}

/**@brief Abort current dfu and release resources
 *
 * @details This function is called when the user decides to cancel the firmware update process.
 *          It will release the resources allocated for the dfu target and reset the state.
 */
void abort_dfu(void)
{
    if (dfu_target_initialized)
    {
        dfu_target_initialized = false;
        dfu_target_mcuboot_done(false);
    }
}

/**
 * @brief Handle a FOTA chunk received from the server.
 *
 * @param[in] payload Pointer to the data chunk received.
 * @param[in] len Length of the data chunk.
 * @param[in,out] file_offset Pointer to the current file offset, which will be updated after writing the chunk.
 *
 * @retval 0 If successful, negative error code otherwise.
 */
int handle_fota_chunk(const uint8_t *payload, size_t len, uint32_t *file_offset)
{
    size_t offset_before, offset_after;

    if (len <= 0) {
        LOG_ERR("FOTA chunk too short");
        return FUOTA_HANDLE_ERR;
    }

    int ret = dfu_target_mcuboot_offset_get(&offset_before);
    if (ret != FUOTA_HANDLE_OK) {
        LOG_ERR("error: failed to get offset before write\n");
    } else {
        LOG_DBG("offset before write: 0x%2x\n", offset_before);
    }

    if(offset_before != *file_offset) {
        LOG_ERR("Offset mismatch! Expected: 0x%08x, Got: 0x%08x", *file_offset, offset_before);
        *file_offset = offset_before;  // Update file_offset to match the current offset
        return FUOTA_HANDLE_ERR;
    }

    ret = dfu_target_mcuboot_write(payload, len);
    if (ret != FUOTA_HANDLE_OK) {
        LOG_ERR("dfu_target_write failed: %d", ret);
        *file_offset = offset_before;  // Update file_offset to match the current offset
        return ret;
    } else {
        LOG_DBG("FOTA chunk written: 0x%2x bytes", len);
    }

    ret = dfu_target_mcuboot_offset_get(&offset_after);
    if (ret != FUOTA_HANDLE_OK) {
        LOG_WRN("error: failed to get offset after write\n");
    } else {
        LOG_DBG("offset after write: 0x%2x\n", offset_after);
    }

    if (offset_after != offset_before + len) {
        *file_offset = offset_before;  // Update file_offset to match the current offset
        LOG_WRN("error: offset mismatch after write\n");
        ret = FUOTA_HANDLE_ERR;  // Indicate error
    } else {
        LOG_DBG("offset match after write\n");
    }

    *file_offset = offset_after;  // Update file_offset for next chunk
    LOG_INF("File_offset updated: 0x%2x\n", *file_offset);

    return ret;
}
```
